## walkterm-main/components/cardkb/Kconfig.projbuild
```kconfig
menu "kardkb configuration"
    config GPIO_RANGE_MAX
		int
		default 33 if IDF_TARGET_ESP32
		default 46 if IDF_TARGET_ESP32S2
		default 48 if IDF_TARGET_ESP32S3
		default 18 if IDF_TARGET_ESP32C2
		default 19 if IDF_TARGET_ESP32C3
		default 30 if IDF_TARGET_ESP32C6
		default 54 if IDF_TARGET_ESP32P4

    config I2C_MASTER_SCL_IO
		int "SCL"
		range 0 33
		default 22
		help
			SCL pin on esp32

	config I2C_MASTER_SDA_IO
		int "SDA"
		range 0 33
		default 21
		help
            SDA pin on esp32

	config I2C_MASTER_FREQ_HZ
		int "I2C frequency"
		range 100000 400000
		default 100000

	config CARDKB_ADDR
	   int cardkb_address
	   range 0 127
	   default 95

endmenu
```

## walkterm-main/components/walktermlib/Kconfig.projbuild
```kconfig
menu "Walkterm configuration"

choice
    prompt "Select display driver"
    default WALKTERM_ST7789

config WALKTERM_ST7789
    bool "ST7789 display driver"

config WALKTERM_SSD1306
    bool "SSD1306 display driver"

endchoice

endmenu
```
